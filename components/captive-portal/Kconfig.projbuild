## components/captive-portal/Kconfig.projbuild
```kconfig
# wifi-captive-portal-esp-idf-component
#
# Copyright (c) 2021 Jeremy Carter <jeremy@jeremycarter.ca>
#
# This code is released under the license terms contained in the
# file named LICENSE, which is found in the top-level folder in
# this project. You must agree to follow those license terms,
# otherwise you aren't allowed to copy, distribute, or use any
# part of this project in any way.

menu "[<>] Captive Portal Configuration"
    comment " ----- Captive Portal Settings ----- "

    config CAPTIVE_PORTAL_DNS_PAGE_NAME
        string "Captive Portal DNS Page Name"
        default "http://wifi-captive-portal/"
        help
            The URL that the captive portal DNS will resolve all requests to.

    config CAPTIVE_PORTAL_DNS_URI
        string "Captive Portal DNS URI"
        default "http://senvis.local"
        help
            The URI used by the captive portal DNS.

    config CAPTIVE_PORTAL_DNS_NS
        string "Captive Portal DNS NS Record"
        default "ns"
        help
            The NS record for the captive portal DNS.

    comment " ----- End Captive Portal Settings ----- "

endmenu
```
